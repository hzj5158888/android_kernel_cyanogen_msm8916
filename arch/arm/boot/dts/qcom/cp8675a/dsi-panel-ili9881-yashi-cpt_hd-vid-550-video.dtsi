/* Copyright (c) 2014, The Linux Foundation. All rights reserved.
 *
 * This program is free software; you can redistribute it and/or modify
 * it under the terms of the GNU General Public License version 2 and
 * only version 2 as published by the Free Software Foundation.
 *
 * This program is distributed in the hope that it will be useful,
 * but WITHOUT ANY WARRANTY; without even the implied warranty of
 * MERCHANTABILITY or FITNESS FOR A PARTICULAR PURPOSE.  See the
 * GNU General Public License for more details.
 */

&mdss_mdp {
	dsi_ili9881_yashi_cpt_hd_vid: qcom,mdss_dsi_ili9881_yashi_cpt_hd_video {
				qcom,cont-splash-enabled;
				qcom,mdss-dsi-panel-name = "LCD_TYPE_ILI9881_YASHI_CPT_HD_550";
				qcom,mdss-dsi-panel-controller = <0x6b>;
				qcom,mdss-dsi-panel-type = "dsi_video_mode";
				qcom,mdss-dsi-panel-destination = "display_1";
				qcom,mdss-dsi-panel-framerate = <0x37>;
				qcom,mdss-dsi-virtual-channel-id = <0x0>;
				qcom,mdss-dsi-stream = <0x0>;
				qcom,mdss-dsi-panel-width = <0x2d0>;
				qcom,mdss-dsi-panel-height = <0x500>;
				qcom,mdss-dsi-h-front-porch = <0x50>;
				qcom,mdss-dsi-h-back-porch = <0x82>;
				qcom,mdss-dsi-h-pulse-width = <0xa>;
				qcom,mdss-dsi-h-sync-skew = <0x0>;
				qcom,mdss-dsi-v-back-porch = <0x14>;
				qcom,mdss-dsi-v-front-porch = <0x14>;
				qcom,mdss-dsi-v-pulse-width = <0x2>;
				qcom,mdss-dsi-h-left-border = <0x0>;
				qcom,mdss-dsi-h-right-border = <0x0>;
				qcom,mdss-dsi-v-top-border = <0x0>;
				qcom,mdss-dsi-v-bottom-border = <0x0>;
				qcom,mdss-dsi-bpp = <0x18>;
				qcom,mdss-dsi-underflow-color = <0xff>;
				qcom,mdss-dsi-border-color = <0x0>;
				qcom,mdss-dsi-pixel-packing = <0x0>;
				qcom,mdss-dsi-on-command = [39 01 00 00 00 00 04 ff 98 81 07 39 01 00 00 00 00 02 03 20 39 01 00 00 00 00 02 04 06 39 01 00 00 00 00 02 05 00 39 01 00 00 00 00 02 06 01 39 01 00 00 00 00 02 07 00 39 01 00 00 00 00 02 08 00 39 01 00 00 00 00 02 09 00 39 01 00 00 00 00 02 0a 01 39 01 00 00 00 00 02 0b 2f 39 01 00 00 00 00 02 0c 00 39 01 00 00 00 00 02 0d 00 39 01 00 00 00 00 02 0e 00 39 01 00 00 00 00 02 0f 00 39 01 00 00 00 00 02 10 44 39 01 00 00 00 00 02 11 02 39 01 00 00 00 00 02 12 03 39 01 00 00 00 00 02 13 00 39 01 00 00 00 00 02 14 00 39 01 00 00 00 00 02 15 00 39 01 00 00 00 00 02 16 2f 39 01 00 00 00 00 02 17 2f 39 01 00 00 00 00 02 18 00 39 01 00 00 00 00 02 19 00 39 01 00 00 00 00 02 1a 00 39 01 00 00 00 00 02 1b 50 39 01 00 00 00 00 02 1c bb 39 01 00 00 00 00 02 1d 0c 39 01 00 00 00 00 02 1e 00 39 01 00 00 00 00 02 1f 00 39 01 00 00 00 00 02 20 00 39 01 00 00 00 00 02 21 00 39 01 00 00 00 00 02 22 00 39 01 00 00 00 00 02 23 c0 39 01 00 00 00 00 02 24 30 39 01 00 00 00 00 02 25 00 39 01 00 00 00 00 02 26 00 39 01 00 00 00 00 02 27 03 39 01 00 00 00 00 02 30 01 39 01 00 00 00 00 02 31 23 39 01 00 00 00 00 02 32 45 39 01 00 00 00 00 02 33 67 39 01 00 00 00 00 02 34 89 39 01 00 00 00 00 02 35 ab 39 01 00 00 00 00 02 36 01 39 01 00 00 00 00 02 37 23 39 01 00 00 00 00 02 38 45 39 01 00 00 00 00 02 39 67 39 01 00 00 00 00 02 3a 89 39 01 00 00 00 00 02 3b ab 39 01 00 00 00 00 02 3c cd 39 01 00 00 00 00 02 3d ef 39 01 00 00 00 00 02 50 11 39 01 00 00 00 00 02 51 06 39 01 00 00 00 00 02 52 0c 39 01 00 00 00 00 02 53 0d 39 01 00 00 00 00 02 54 0e 39 01 00 00 00 00 02 55 0f 39 01 00 00 00 00 02 56 02 39 01 00 00 00 00 02 57 02 39 01 00 00 00 00 02 58 02 39 01 00 00 00 00 02 59 02 39 01 00 00 00 00 02 5a 02 39 01 00 00 00 00 02 5b 02 39 01 00 00 00 00 02 5c 02 39 01 00 00 00 00 02 5d 02 39 01 00 00 00 00 02 5e 02 39 01 00 00 00 00 02 5f 02 39 01 00 00 00 00 02 60 05 39 01 00 00 00 00 02 61 05 39 01 00 00 00 00 02 62 05 39 01 00 00 00 00 02 63 02 39 01 00 00 00 00 02 64 01 39 01 00 00 00 00 02 65 00 39 01 00 00 00 00 02 66 08 39 01 00 00 00 00 02 67 08 39 01 00 00 00 00 02 68 0c 39 01 00 00 00 00 02 69 0d 39 01 00 00 00 00 02 6a 0e 39 01 00 00 00 00 02 6b 0f 39 01 00 00 00 00 02 6c 02 39 01 00 00 00 00 02 6d 02 39 01 00 00 00 00 02 6e 02 39 01 00 00 00 00 02 6f 02 39 01 00 00 00 00 02 70 02 39 01 00 00 00 00 02 71 02 39 01 00 00 00 00 02 72 02 39 01 00 00 00 00 02 73 02 39 01 00 00 00 00 02 74 02 39 01 00 00 00 00 02 75 02 39 01 00 00 00 00 02 76 05 39 01 00 00 00 00 02 77 05 39 01 00 00 00 00 02 78 05 39 01 00 00 00 00 02 79 02 39 01 00 00 00 00 02 7a 01 39 01 00 00 00 00 02 7b 00 39 01 00 00 00 00 02 7c 06 39 01 00 00 00 00 04 ff 98 81 08 39 01 00 00 00 00 02 76 b4 39 01 00 00 00 00 02 78 02 39 01 00 00 00 00 02 74 2b 39 01 00 00 00 00 02 8e 15 39 01 00 00 00 00 02 40 01 39 01 00 00 00 00 02 7b 04 39 01 00 00 00 00 02 72 25 39 01 00 00 00 00 02 87 3a 39 01 00 00 00 00 02 7e 4c 39 01 00 00 00 00 02 6c 05 39 01 00 00 00 00 02 49 10 39 01 00 00 00 00 02 2d 80 39 01 00 00 00 00 02 50 65 39 01 00 00 00 00 02 53 29 39 01 00 00 00 00 02 54 65 39 01 00 00 00 00 02 55 38 39 01 00 00 00 00 02 57 47 39 01 00 00 00 00 02 58 47 39 01 00 00 00 00 04 ff 98 81 01 39 01 00 00 00 00 02 22 0a 39 01 00 00 00 00 02 53 7c 39 01 00 00 00 00 02 55 78 39 01 00 00 00 00 02 50 a6 39 01 00 00 00 00 02 51 a8 39 01 00 00 00 00 02 31 00 39 01 00 00 00 00 02 a0 00 39 01 00 00 00 00 02 a1 18 39 01 00 00 00 00 02 a2 25 39 01 00 00 00 00 02 a3 12 39 01 00 00 00 00 02 a4 14 39 01 00 00 00 00 02 a5 26 39 01 00 00 00 00 02 a6 19 39 01 00 00 00 00 02 a7 1c 39 01 00 00 00 00 02 a8 87 39 01 00 00 00 00 02 a9 1d 39 01 00 00 00 00 02 aa 29 39 01 00 00 00 00 02 ab 84 39 01 00 00 00 00 02 ac 1f 39 01 00 00 00 00 02 ad 1e 39 01 00 00 00 00 02 ae 52 39 01 00 00 00 00 02 af 25 39 01 00 00 00 00 02 b0 2a 39 01 00 00 00 00 02 b1 50 39 01 00 00 00 00 02 b2 5e 39 01 00 00 00 00 02 b3 3f 39 01 00 00 00 00 02 c0 00 39 01 00 00 00 00 02 c1 16 39 01 00 00 00 00 02 c2 23 39 01 00 00 00 00 02 c3 12 39 01 00 00 00 00 02 c4 14 39 01 00 00 00 00 02 c5 25 39 01 00 00 00 00 02 c6 19 39 01 00 00 00 00 02 c7 1c 39 01 00 00 00 00 02 c8 85 39 01 00 00 00 00 02 c9 1d 39 01 00 00 00 00 02 ca 29 39 01 00 00 00 00 02 cb 83 39 01 00 00 00 00 02 cc 1f 39 01 00 00 00 00 02 cd 1e 39 01 00 00 00 00 02 ce 52 39 01 00 00 00 00 02 cf 25 39 01 00 00 00 00 02 d0 2a 39 01 00 00 00 00 02 d1 50 39 01 00 00 00 00 02 d2 5d 39 01 00 00 00 00 02 d3 3f 39 01 00 00 00 00 04 ff 98 81 06 39 01 00 00 00 00 02 00 04 39 01 00 00 00 00 04 ff 98 81 00 39 01 00 00 00 00 02 35 00 39 01 00 00 00 00 02 51 00 39 01 00 00 00 00 02 53 24 39 01 00 00 00 00 02 55 b0 05 01 00 00 78 00 02 11 00 05 01 00 00 14 00 02 29 00];
				qcom,mdss-dsi-off-command = [05 01 00 00 14 00 02 28 00 05 01 00 00 78 00 02 10 00];
				qcom,panel-ce-cmds = [39 01 00 00 00 00 02 55 93];
				qcom,panel-ce-off-cmds = [39 01 00 00 00 00 02 55 00];
				qcom,panel-ce-level1-cmds = [39 01 00 00 00 00 02 55 b0];
				qcom,panel-ce-level2-cmds = [39 01 00 00 00 00 02 55 90];
				qcom,panel-ce-level3-cmds = [39 01 00 00 00 00 02 55 b1];
				qcom,panel-cabc-ui-cmds = [39 01 00 00 00 00 02 55 91];
				qcom,panel-cabc-still-cmds = [39 01 00 00 00 00 02 55 92];
				qcom,panel-cabc-moving-cmds = [39 01 00 00 00 00 02 55 93];
				qcom,panel-cabc-off-cmds = [39 01 00 00 00 00 02 55 00];
				qcom,panel-backlight-response-curve = <0x10101 0x2020303 0x4040505 0x6060707 0x7080808 0x909090a 0xa0a0a0b 0xb0b0b0c 0xc0d0d0e 0xe0f0f10 0x10111112 0x12131314 0x14151616 0x17181819 0x1a1b1b1c 0x1d1d1e1f 0x21212122 0x23232425 0x26262727 0x28282929 0x2a2a2b2b 0x2c2c2d2d 0x2e2e2f2f 0x30303131 0x31323233 0x33333434 0x34353738 0x3a3b3d3e 0x3f404142 0x43444546 0x4748494a 0x4b4c4d4e 0x4f505151 0x52535454 0x55565757 0x58595a5b 0x5c5e5f61 0x62646567 0x686a6b6c 0x6e6f7172 0x74757778 0x7a7b7d7e 0x7f818284 0x8587898b 0x8c8d8e90 0x91929495 0x97989a9b 0x9d9ea0a1 0xa3a4a5a7 0xa8aaabad 0xaeafb1b3 0xb4b5b7b8 0xbabbbdbe 0xbfc1c4c5 0xc7c8c9ca 0xcbcdced0 0xd1d3d4d6 0xd7d9dadb 0xdddee0e1 0xe3e4e6e7 0xe9eaeced 0xeef0f1f3 0xf4f6f7f9 0xfafcfdff>;
				qcom,mdss-dsi-on-command-state = "dsi_lp_mode";
				qcom,mdss-dsi-off-command-state = "dsi_lp_mode";
				qcom,panel-alive-reg-content = [0a 03 9c 00 00];
				qcom,mdss-dsi-panel-status-command = [06 01 00 01 05 00 02 09 08];
				qcom,mdss-dsi-panel-status-command-state = "dsi_lp_mode";
				qcom,mdss-dsi-panel-status-check-mode = "reg_read";
				qcom,mdss-ili9881-ic-flag;
				qcom,mdss-dsi-h-sync-pulse = <0x1>;
				qcom,mdss-dsi-traffic-mode = "burst_mode";
				qcom,mdss-dsi-bllp-eof-power-mode;
				qcom,mdss-dsi-bllp-power-mode;
				qcom,mdss-dsi-lane-0-state;
				qcom,mdss-dsi-lane-1-state;
				qcom,mdss-dsi-lane-2-state;
				qcom,mdss-dsi-lane-3-state;
				qcom,mdss-dsi-panel-timings = <0x831a1000 0x3c42141c 0x15030400>;
				qcom,mdss-dsi-t-clk-post = <0x4>;
				qcom,mdss-dsi-t-clk-pre = <0x1b>;
				qcom,mdss-dsi-bl-min-level = <0x1>;
				qcom,mdss-dsi-bl-max-level = <0xff>;
				qcom,mdss-dsi-dma-trigger = "trigger_sw";
				qcom,mdss-dsi-mdp-trigger = "none";
				qcom,mdss-dsi-bl-pmic-control-type = "bl_ctrl_dcs";
				qcom,mdss-dsi-reset-sequence = <0x1 0xa 0x0 0x2 0x1 0xa 0x0 0x2 0x1 0x3c>;
				qcom,mdss-pan-physical-width-dimension = <0x44>;
				qcom,mdss-pan-physical-height-dimension = <0x79>;
				qcom,mdss-dsi-lp11-init;
				qcom,mdss-dsi-init-delay-us = <0xc8>;
			};

};
