/* Copyright (c) 2014, The Linux Foundation. All rights reserved.
 *
 * This program is free software; you can redistribute it and/or modify
 * it under the terms of the GNU General Public License version 2 and
 * only version 2 as published by the Free Software Foundation.
 *
 * This program is distributed in the hope that it will be useful,
 * but WITHOUT ANY WARRANTY; without even the implied warranty of
 * MERCHANTABILITY or FITNESS FOR A PARTICULAR PURPOSE.  See the
 * GNU General Public License for more details.
 */

&mdss_mdp {
	dsi_otm1284a_boyi_cpt_hd_vid: qcom,mdss_dsi_otm1284a_boyi_cpt_hd_video {
		qcom,cont-splash-enabled;
		qcom,mdss-dsi-panel-name = "LCD_TYPE_OTM1284A_BOYI_CPT_HD_550";
		qcom,mdss-dsi-panel-controller = <&mdss_dsi0>;
		qcom,mdss-dsi-panel-type = "dsi_video_mode";
		qcom,mdss-dsi-panel-destination = "display_1";
		qcom,mdss-dsi-panel-framerate = <55>;
		qcom,mdss-dsi-virtual-channel-id = <0>;
		qcom,mdss-dsi-stream = <0>;
		qcom,mdss-dsi-panel-width = <720>;
		qcom,mdss-dsi-panel-height = <1280>;
		qcom,mdss-dsi-h-front-porch = <44>;
		qcom,mdss-dsi-h-back-porch = <42>;
		qcom,mdss-dsi-h-pulse-width = <6>;
		qcom,mdss-dsi-h-sync-skew = <0>;
		qcom,mdss-dsi-v-front-porch = <16>;
		qcom,mdss-dsi-v-back-porch = <14>;
		qcom,mdss-dsi-v-pulse-width = <2>;
		qcom,mdss-dsi-h-left-border = <0>;
		qcom,mdss-dsi-h-right-border = <0>;
		qcom,mdss-dsi-v-top-border = <0>;
		qcom,mdss-dsi-v-bottom-border = <0>;
		qcom,mdss-dsi-bpp = <24>;
		qcom,mdss-dsi-underflow-color = <0xff>;
		qcom,mdss-dsi-border-color = <0>;
		qcom,mdss-dsi-pixel-packing = <0>;
		qcom,mdss-dsi-on-command = [
			29 01 00 00 00 00 02 00 00
			29 01 00 00 00 00 04 FF 12 84 01
			29 01 00 00 00 00 02 00 80
			29 01 00 00 00 00 03 FF 12 84
			29 01 00 00 00 00 02 00 92
			29 01 00 00 00 00 03 FF 30 02
			29 01 00 00 00 00 02 00 80
			29 01 00 00 00 00 0A C0 00 64 00 10 10 00 64 10 10
			29 01 00 00 00 00 02 00 90
			29 01 00 00 00 00 07 C0 00 5C 00 01 00 04
			29 01 00 00 00 00 02 00 B3
			29 01 00 00 00 00 03 C0 00 55
			29 01 00 00 00 00 02 00 81
			29 01 00 00 00 00 02 C1 55
			29 01 00 00 00 00 02 00 A0
			29 01 00 00 00 00 0F C4 05 10 06 02 05 15 10 05 10 07 02 05 15 10
			29 01 00 00 00 00 02 00 B0
			29 01 00 00 00 00 03 C4 00 00
			29 01 00 00 00 00 02 00 91
			29 01 00 00 00 00 03 C5 46 42
			29 01 00 00 00 00 02 00 00
			29 01 00 00 00 00 03 D8 BC BC
			29 01 00 00 00 00 02 00 B3
			29 01 00 00 00 00 02 C5 84
			29 01 00 00 00 00 02 00 BB
			29 01 00 00 00 00 02 C5 8A
			29 01 00 00 00 00 02 00 82
			29 01 00 00 00 00 02 C4 0A
			29 01 00 00 00 00 02 00 C6
			29 01 00 00 00 00 02 B0 03
			29 01 00 00 00 00 02 00 C2
			29 01 00 00 00 00 03 F5 40 85
			29 01 00 00 00 00 02 00 87
			29 01 00 00 00 00 02 C4 18
			29 01 00 00 00 00 02 00 00
			29 01 00 00 00 00 02 D0 40
			29 01 00 00 00 00 02 00 00
			29 01 00 00 00 00 03 D1 00 00
			29 01 00 00 00 00 02 00 80
			29 01 00 00 00 00 0C CB 00 00 00 00 00 00 00 00 00 00 00
			29 01 00 00 00 00 02 00 90
			29 01 00 00 00 00 10 CB 00 00 00 00 00 00 00 00 00 00 00 00 00 00 00
			29 01 00 00 00 00 02 00 A0
			29 01 00 00 00 00 10 CB 00 00 00 00 00 00 00 00 00 00 00 00 00 00 00
			29 01 00 00 00 00 02 00 B0
			29 01 00 00 00 00 10 CB 00 00 00 00 00 00 00 00 00 00 00 00 00 00 00
			29 01 00 00 00 00 02 00 C0
			29 01 00 00 00 00 10 CB 05 05 05 05 05 00 00 00 00 00 00 00 00 00 00
			29 01 00 00 00 00 02 00 D0
			29 01 00 00 00 00 10 CB FF FF FF 00 05 05 05 05 05 05 05 05 00 00 00
			29 01 00 00 00 00 02 00 E0
			29 01 00 00 00 00 0F CB 00 00 00 00 00 00 00 FF FF FF 00 05 05 05
			29 01 00 00 00 00 02 00 F0
			29 01 00 00 00 00 0C CB FF FF FF FF FF FF FF FF FF FF FF
			29 01 00 00 00 00 02 00 80
			29 01 00 00 00 00 10 CC 02 0A 0C 0E 10 00 00 00 00 00 00 00 00 00 00
			29 01 00 00 00 00 02 00 90
			29 01 00 00 00 00 10 CC 00 00 00 00 2E 2D 06 01 09 0B 0D 0F 00 00 00
			29 01 00 00 00 00 02 00 A0
			29 01 00 00 00 00 0F CC 00 00 00 00 00 00 00 00 00 00 00 2E 2D 05
			29 01 00 00 00 00 02 00 B0
			29 01 00 00 00 00 10 CC 05 0F 0D 0B 09 00 00 00 00 00 00 00 00 00 00
			29 01 00 00 00 00 02 00 C0
			29 01 00 00 00 00 10 CC 00 00 00 00 2D 2E 01 06 10 0E 0C 0A 00 00 00
			29 01 00 00 00 00 02 00 D0
			29 01 00 00 00 00 0F CC 00 00 00 00 00 00 00 00 00 00 00 2D 2E 02
			29 01 00 00 00 00 02 00 80
			29 01 00 00 00 00 0D CE 87 03 10 86 03 10 00 00 00 00 00 00
			29 01 00 00 00 00 02 00 90
			29 01 00 00 00 00 0F CE 35 01 10 35 02 10 00 00 00 00 00 00 00 00
			29 01 00 00 00 00 02 00 A0
			29 01 00 00 00 00 0F CE 38 03 04 F8 00 10 00 38 02 04 F9 00 10 00
			29 01 00 00 00 00 02 00 B0
			29 01 00 00 00 00 0F CE 38 01 04 FA 00 10 00 38 00 04 FB 00 10 00
			29 01 00 00 00 00 02 00 C0
			29 01 00 00 00 00 0F CE 30 00 04 FC 00 10 00 30 01 04 FD 00 10 00
			29 01 00 00 00 00 02 00 D0
			29 01 00 00 00 00 0F CE 30 02 04 FE 00 10 00 30 03 04 FF 00 10 00
			29 01 00 00 00 00 02 00 80
			29 01 00 00 00 00 0F CF 00 00 00 00 00 00 00 00 00 00 00 00 00 00
			29 01 00 00 00 00 02 00 90
			29 01 00 00 00 00 0F CF 00 00 00 00 00 00 00 00 00 00 00 00 00 00
			29 01 00 00 00 00 02 00 A0
			29 01 00 00 00 00 0F CF 00 00 00 00 00 00 00 00 00 00 00 00 00 00
			29 01 00 00 00 00 02 00 B0
			29 01 00 00 00 00 0F CF 00 00 00 00 00 00 00 00 00 00 00 00 00 00
			29 01 00 00 00 00 02 00 C0
			29 01 00 00 00 00 0C CF 01 01 20 20 00 00 01 81 00 03 08
			29 01 00 00 00 00 02 00 B5
			29 01 00 00 00 00 07 C5 3F FF FF 3F FF FF
			29 01 00 00 00 00 02 00 90
			29 01 00 00 00 00 05 F5 02 11 02 15
			29 01 00 00 00 00 02 00 90
			29 01 00 00 00 00 02 C5 50
			29 01 00 00 00 00 02 00 94
			29 01 00 00 00 00 02 C5 66
			29 01 00 00 00 00 02 00 B2
			29 01 00 00 00 00 09 F5 00 00 00 00 00 00 00 00
			29 01 00 00 00 00 02 00 94
			29 01 00 00 00 00 03 F5 00 00
			29 01 00 00 00 00 02 00 D2
			29 01 00 00 00 00 03 F5 06 15
			29 01 00 00 00 00 02 00 B4
			29 01 00 00 00 00 02 C5 CC
			29 01 00 00 00 00 02 00 00
			29 01 00 00 00 00 15 E1 00 14 22 2e 40 4e 51 81 75 92 6f 58 6a 48 47 3c 2e 1f 0e 00
			29 01 00 00 00 00 02 00 00
			29 01 00 00 00 00 15 E2 00 14 22 2e 40 4e 51 81 75 92 70 59 6B 47 47 3c 2e 1f 0e 00
			29 01 00 00 00 00 02 00 00
			29 01 00 00 00 00 22 EC 40 44 43 44 44 34 44 44 44 43 44 44 34 44 44 44 34 44 44 44 43 44 44 34 44 44 44 43 44 44 34 44 04
			29 01 00 00 00 00 02 00 00
			29 01 00 00 00 00 22 ED 40 44 44 44 44 44 44 44 44 44 44 44 44 44 44 44 44 44 44 44 44 44 44 44 44 44 44 44 44 44 44 44 04
			29 01 00 00 00 00 02 00 00
			29 01 00 00 00 00 22 EE 40 43 43 43 34 34 44 43 43 43 34 34 34 44 43 43 34 34 34 44 43 43 43 34 34 34 44 43 43 34 34 34 04
			29 01 00 00 00 00 02 00 A0
			29 01 00 00 00 00 0D D6 01 0d 01 0d 01 a6 01 a6 01 a6 01 a6
			29 01 00 00 00 00 02 00 B0
			29 01 00 00 00 00 0D D6 01 a6 01 a6 01 a6 01 a6 01 a6 01 a6
			29 01 00 00 00 00 02 00 C0
			29 01 00 00 00 00 0D D6 55 11 09 6f 11 6f 6f 11 6f 6f 11 6f
			29 01 00 00 00 00 02 00 D0
			29 01 00 00 00 00 07 D6 6f 11 6f 6f 11 6f
			29 01 00 00 00 00 02 00 E0
			29 01 00 00 00 00 0D D6 2b 11 37 37 11 37 37 11 37 37 11 37
			29 01 00 00 00 00 02 00 F0
			29 01 00 00 00 00 07 D6 37 11 37 37 11 37
			29 01 00 00 00 00 02 00 80
			29 01 00 00 00 00 1D CA 01 8e 95 9d a4 ab b2 ba c1 c8 cf d7 de e5 ec f4 e8 ff 87 ff 87 ff 05 03 05 03 05 03
			29 01 00 00 00 00 02 00 00
			29 01 00 00 00 00 02 C6 10
			29 01 00 00 00 00 13 c7 90 A9 AA AA AA AA AA AA 99 88 88 88 77 66 55 55 55 55
			29 01 00 00 00 00 02 00 00
			29 01 00 00 00 00 02 C6 11
			29 01 00 00 00 00 13 c7 90 99 AA AA AA AA AA 9A 99 88 88 88 77 66 66 55 55 55
			29 01 00 00 00 00 02 00 00
			29 01 00 00 00 00 02 C6 12
			29 01 00 00 00 00 13 c7 90 99 A9 AA AA AA AA 99 99 88 88 88 77 66 66 66 55 55
			29 01 00 00 00 00 02 00 00
			29 01 00 00 00 00 02 C6 13
			29 01 00 00 00 00 13 c7 90 99 99 AA AA AA 9A 99 99 88 88 88 77 66 66 66 66 55
			29 01 00 00 00 00 02 00 00
			29 01 00 00 00 00 02 C6 14
			29 01 00 00 00 00 13 c7 90 99 99 A9 AA AA 99 99 99 88 88 88 77 66 66 66 66 66
			29 01 00 00 00 00 02 00 00
			29 01 00 00 00 00 02 C6 15
			29 01 00 00 00 00 13 c7 90 99 99 99 AA 9A 99 99 99 88 88 88 77 77 66 66 66 66
			29 01 00 00 00 00 02 00 00
			29 01 00 00 00 00 02 C6 16
			29 01 00 00 00 00 13 c7 90 99 99 99 A9 99 99 99 99 88 88 88 77 77 77 66 66 66
			29 01 00 00 00 00 02 00 00
			29 01 00 00 00 00 02 C6 17
			29 01 00 00 00 00 13 c7 80 99 99 99 99 99 99 99 99 88 88 88 77 77 77 77 66 66
			29 01 00 00 00 00 02 00 00
			29 01 00 00 00 00 02 C6 18
			29 01 00 00 00 00 13 c7 80 98 99 99 99 98 99 99 99 88 88 88 77 77 77 77 77 66
			29 01 00 00 00 00 02 00 00
			29 01 00 00 00 00 02 C6 19
			29 01 00 00 00 00 13 c7 80 88 99 99 99 88 99 99 99 88 88 88 77 77 77 77 77 77
			29 01 00 00 00 00 02 00 00
			29 01 00 00 00 00 02 C6 1A
			29 01 00 00 00 00 13 c7 80 88 98 99 99 88 98 99 99 88 88 88 88 77 77 77 77 77
			29 01 00 00 00 00 02 00 00
			29 01 00 00 00 00 02 C6 1B
			29 01 00 00 00 00 13 c7 80 88 88 99 99 88 88 99 99 88 88 88 88 88 77 77 77 77
			29 01 00 00 00 00 02 00 00
			29 01 00 00 00 00 02 C6 1C
			29 01 00 00 00 00 13 c7 80 88 88 98 99 88 88 98 99 88 88 88 88 88 88 77 77 77
			29 01 00 00 00 00 02 00 00
			29 01 00 00 00 00 02 C6 1D
			29 01 00 00 00 00 13 c7 80 88 88 88 99 88 88 88 99 88 88 88 88 88 88 88 77 77
			29 01 00 00 00 00 02 00 00
			29 01 00 00 00 00 02 C6 1E
			29 01 00 00 00 00 13 c7 80 88 88 88 98 88 88 88 98 88 88 88 88 88 88 88 78 78
			29 01 00 00 00 00 02 00 00
			29 01 00 00 00 00 02 C6 1F
			29 01 00 00 00 00 13 c7 80 88 88 88 88 88 88 88 88 88 88 88 88 88 88 88 88 88
			29 01 00 00 00 00 02 00 00
			29 01 00 00 00 00 02 C6 00
			29 01 00 00 00 00 02 00 B1
			29 01 00 00 00 00 02 C6 04
			29 01 00 00 00 00 02 00 B4
			29 01 00 00 00 00 02 C6 12
			29 01 00 00 00 00 02 00 00
			29 01 00 00 00 00 04 FF FF FF FF
			29 01 00 00 00 00 02 51 00
			29 01 00 00 00 00 02 53 24
			05 01 00 00 01 00 02 11 00
			05 01 00 00 00 00 02 29 00
		];
		qcom,mdss-dsi-off-command = [
			05 01 00 00 14 00 02 28 00
			05 01 00 00 78 00 02 10 00];
		qcom,panel-ce-cmds = [
			29 01 00 00 00 00 02 81 81
		];
		qcom,panel-ce-off-cmds = [
			29 01 00 00 00 00 02 81 00
		];
		qcom,panel-ce-level1-cmds = [
			29 01 00 00 00 00 02 81 83
		];
		qcom,panel-ce-level2-cmds = [
			29 01 00 00 00 00 02 81 81
		];
		qcom,panel-ce-level3-cmds = [
			29 01 00 00 00 00 02 55 01
			29 01 00 00 00 00 02 81 83
		];
		qcom,panel-cabc-ui-cmds = [
			29 01 00 00 00 00 02 55 01
		];
		qcom,panel-cabc-still-cmds = [
			29 01 00 00 00 00 02 55 02
		];
		qcom,panel-cabc-moving-cmds = [
			29 01 00 00 00 00 02 55 03
		];
		qcom,panel-cabc-off-cmds = [
			29 01 00 00 00 00 02 55 00
		];
		qcom,panel-backlight-response-curve = [
			00 01 01 02 02 03 03 04
			04 05 05 06 06 07 07 08
			08 09 09 0A 0A 0B 0B 0C
			0C 0D 0D 0D 0E 0E 0E 0E
			0F 0F 0F 0F 10 10 10 10
			11 11 11 12 12 12 13 13
			14 15 15 16 17 18 18 19
			1A 1B 1B 1C 1D 1D 1E 1F
			21 21 21 22 23 23 24 25
			26 26 27 27 28 28 29 29
			2A 2A 2B 2B 2C 2C 2D 2D
			2E 2E 2F 2F 30 30 31 31
			31 32 32 33 33 33 34 34
			34 35 37 38 3A 3B 3D 3E
			3F 40 41 42 43 44 45 46
			47 48 49 4A 4B 4C 4D 4E
			4F 50 51 51 52 53 54 54
			55 56 57 57 58 59 5A 5B
			5C 5E 5F 61 62 64 65 67
			68 6A 6B 6C 6E 6F 71 72
			74 75 77 78 7A 7B 7D 7E
			7F 81 82 84 85 87 89 8B
			8C 8D 8E 90 91 92 94 95
			97 98 9A 9B 9D 9E A0 A1
			A3 A4 A5 A7 A8 AA AB AD
			AE AF B1 B3 B4 B5 B7 B8
			BA BB BD BE BF C1 C4 C5
			C7 C8 C9 CA CB CD CE D0
			D1 D3 D4 D6 D7 D9 DA DB
			DD DE E0 E1 E3 E4 E6 E7
			E9 EA EC ED EE F0 F1 F3
			F4 F6 F7 F9 FA FC FD FF
		];
		qcom,mdss-dsi-on-command-state = "dsi_lp_mode";
		qcom,mdss-dsi-off-command-state = "dsi_lp_mode";
		qcom,panel-alive-reg-content = [
			0A 01 9C
			0B 01 00
			0D 01 00
		];
		qcom,mdss-dsi-panel-status-command = [
			06 01 00 01 05 00 02 0A 08
		];
		qcom,mdss-dsi-panel-status-command-state = "dsi_lp_mode";
		qcom,mdss-dsi-panel-status-check-mode = "reg_read_yl";
		qcom,mdss-dsi-h-sync-pulse = <1>;
		qcom,mdss-dsi-traffic-mode = "burst_mode";
		qcom,mdss-dsi-bllp-eof-power-mode;
		qcom,mdss-dsi-bllp-power-mode;
		qcom,mdss-dsi-lane-0-state;
		qcom,mdss-dsi-lane-1-state;
		qcom,mdss-dsi-lane-2-state;
		qcom,mdss-dsi-lane-3-state;
		qcom,mdss-dsi-panel-timings = [81 20 18 00 30 2E 1C 22 27 03 04 00];
		qcom,mdss-dsi-t-clk-post = <0x20>;
		qcom,mdss-dsi-t-clk-pre = <0x2C>;
		qcom,mdss-dsi-bl-min-level = <1>;
		qcom,mdss-dsi-bl-max-level = <255>;
		qcom,mdss-dsi-dma-trigger = "trigger_sw";
		qcom,mdss-dsi-mdp-trigger = "none";
		qcom,mdss-dsi-bl-pmic-control-type = "bl_ctrl_dcs";
		qcom,mdss-dsi-reset-sequence = <1 10>, <0 2>, <1 10>;
		qcom,mdss-pan-physical-width-dimension = <68>;
		qcom,mdss-pan-physical-height-dimension = <121>;
	};
};
