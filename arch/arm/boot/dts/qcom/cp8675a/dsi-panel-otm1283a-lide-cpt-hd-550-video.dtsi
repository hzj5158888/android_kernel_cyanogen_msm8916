/* Copyright (c) 2014, The Linux Foundation. All rights reserved.
 *
 * This program is free software; you can redistribute it and/or modify
 * it under the terms of the GNU General Public License version 2 and
 * only version 2 as published by the Free Software Foundation.
 *
 * This program is distributed in the hope that it will be useful,
 * but WITHOUT ANY WARRANTY; without even the implied warranty of
 * MERCHANTABILITY or FITNESS FOR A PARTICULAR PURPOSE.  See the
 * GNU General Public License for more details.
 */

&mdss_mdp {
	dsi_otm1283a_lide_cpt_hd: qcom,mdss_dsi_otm1283a_lide_cpt_hd_video {
				qcom,cont-splash-enabled;
				qcom,mdss-dsi-panel-name = "LCD_TYPE_OTM1283A_LIDE_CPT_HD_550";
				qcom,mdss-dsi-panel-controller = <0x6b>;
				qcom,mdss-dsi-panel-type = "dsi_video_mode";
				qcom,mdss-dsi-panel-destination = "display_1";
				qcom,mdss-dsi-panel-framerate = <0x37>;
				qcom,mdss-dsi-virtual-channel-id = <0x0>;
				qcom,mdss-dsi-stream = <0x0>;
				qcom,mdss-dsi-panel-width = <0x2d0>;
				qcom,mdss-dsi-panel-height = <0x500>;
				qcom,mdss-dsi-h-front-porch = <0x2c>;
				qcom,mdss-dsi-h-back-porch = <0x2a>;
				qcom,mdss-dsi-h-pulse-width = <0x6>;
				qcom,mdss-dsi-h-sync-skew = <0x0>;
				qcom,mdss-dsi-v-front-porch = <0x10>;
				qcom,mdss-dsi-v-back-porch = <0xe>;
				qcom,mdss-dsi-v-pulse-width = <0x2>;
				qcom,mdss-dsi-h-left-border = <0x0>;
				qcom,mdss-dsi-h-right-border = <0x0>;
				qcom,mdss-dsi-v-top-border = <0x0>;
				qcom,mdss-dsi-v-bottom-border = <0x0>;
				qcom,mdss-dsi-bpp = <0x18>;
				qcom,mdss-dsi-underflow-color = <0xff>;
				qcom,mdss-dsi-border-color = <0x0>;
				qcom,mdss-dsi-pixel-packing = <0x0>;
				qcom,mdss-dsi-on-command = <0x29010000 0x200 0x290100 0x4 0xff128301 0x29010000 0x200 0x80290100 0x3 0xff128329 0x1000000 0x20092 0x29010000 0x3ff 0x30022901 0x0 0x200b929 0x1000000 0x2b051 0x29010000 0x200 0xc6290100 0x2 0xb0032901 0x0 0x2008029 0x1000000 0xac000 0x64001010 0x641010 0x29010000 0x200 0x90290100 0x7 0xc0005c00 0x1000429 0x1000000 0x200a4 0x29010000 0x2c0 0x22290100 0x2 0xb32901 0x0 0x3c00050 0x29010000 0x200 0x81290100 0x2 0xc1772901 0x0 0x2008029 0x1000000 0x2c430 0x29010000 0x200 0x81290100 0x2 0xc4822901 0x0 0x2008229 0x1000000 0x2c402 0x29010000 0x200 0x87290100 0x2 0xc4182901 0x0 0x2008a29 0x1000000 0x2c440 0x29010000 0x200 0x8b290100 0x2 0xc4002901 0x0 0x2009029 0x1000000 0x2c452 0x29010000 0x200 0xa0290100 0xf 0xc4051006 0x2051510 0x5100702 0x5151029 0x1000000 0x200b0 0x29010000 0x3c4 0x2901 0x0 0x2009029 0x1000000 0x5f502 0x11021129 0x1000000 0x20090 0x29010000 0x2c5 0x50290100 0x2 0x942901 0x0 0x2c56629 0x1000000 0x20091 0x29010000 0x3c5 0x46402901 0x0 0x200b029 0x1000000 0x3c504 0x38290100 0x2 0xb52901 0x0 0x7c53fff 0xff3fffff 0x29010000 0x200 0xbb290100 0x2 0xc5802901 0x0 0x200b129 0x1000000 0x2c605 0x29010000 0x200 0xb2290100 0x5 0xf5000000 0x290100 0x2 0x942901 0x0 0x2f50229 0x1000000 0x200ba 0x29010000 0x2f5 0x3290100 0x2 0xc32901 0x0 0x2f58129 0x1000000 0x20080 0x29010000 0xccb 0x0 0x0 0x29 0x1000000 0x20090 0x29010000 0x10cb 0x0 0x0 0x0 0x29 0x1000000 0x200a0 0x29010000 0x10cb 0x0 0x0 0x0 0x29 0x1000000 0x200b0 0x29010000 0x10cb 0x0 0x0 0x0 0x29 0x1000000 0x200c0 0x29010000 0x10cb 0x5050505 0x5000000 0x0 0x29 0x1000000 0x200d0 0x29010000 0x10cb 0xffffff00 0x5050505 0x5050505 0x29 0x1000000 0x200e0 0x29010000 0xfcb 0x0 0xff 0xffff0005 0x5052901 0x0 0x200f029 0x1000000 0xccbff 0xffffffff 0xffffffff 0xffff2901 0x0 0x2008029 0x1000000 0x10cc02 0xa0c0e10 0x0 0x0 0x2901 0x0 0x2009029 0x1000000 0x10cc00 0x2e 0x2d060109 0xb0d0f00 0x2901 0x0 0x200a029 0x1000000 0xfcc00 0x0 0x0 0x2e2d 0x5290100 0x2 0xb02901 0x0 0x10cc050f 0xd0b0900 0x0 0x0 0x290100 0x2 0xc02901 0x0 0x10cc0000 0x2d2e 0x106100e 0xc0a0000 0x290100 0x2 0xd02901 0x0 0xfcc0000 0x0 0x0 0x2d2e02 0x29010000 0x200 0x80290100 0xd 0xce870310 0x86031000 0x0 0x290100 0x2 0x902901 0x0 0xfce3501 0x10350210 0x0 0x0 0x29010000 0x200 0xa0290100 0xf 0xce380304 0xf8001000 0x380204f9 0x100029 0x1000000 0x200b0 0x29010000 0xfce 0x380104fa 0x100038 0x4fb00 0x10002901 0x0 0x200c029 0x1000000 0xfce30 0x4fc00 0x10003001 0x4fd0010 0x290100 0x2 0xd02901 0x0 0xfce3002 0x4fe0010 0x300304 0xff001000 0x29010000 0x200 0x80290100 0xf 0xcf000000 0x0 0x0 0x29 0x1000000 0x20090 0x29010000 0xfcf 0x0 0x0 0x0 0x2901 0x0 0x200a029 0x1000000 0xfcf00 0x0 0x0 0x0 0x290100 0x2 0xb02901 0x0 0xfcf0000 0x0 0x0 0x0 0x29010000 0x200 0xc0290100 0xc 0xcf010120 0x20000001 0x81000308 0x29010000 0x200 0x290100 0x3 0xd8b6b629 0x1000000 0x20000 0x29010000 0x2d9 0x6a290100 0x2 0x2901 0x0 0x11e1020a 0x100d060f 0xb0b0206 0xb080f12 0xc062901 0x0 0x2000029 0x1000000 0x11e202 0xa100d06 0xf0b0a03 0x60b080f 0x110c0629 0x1000000 0x20000 0x29010000 0x22ec 0x40444444 0x44444444 0x44444444 0x44444444 0x44444444 0x44444444 0x44444444 0x44444444 0x4290100 0x2 0x2901 0x0 0x22ed4034 0x44344434 0x44344444 0x43444344 0x43443444 0x34443444 0x34444443 0x44434443 0x44430429 0x1000000 0x20000 0x29010000 0x22ee 0x30343434 0x43433334 0x34344343 0x43333434 0x34434333 0x34343443 0x43433334 0x34434343 0x3290100 0x2 0xa02901 0x0 0xdd60100 0x1000100 0x1b301f3 0x1b32901 0x0 0x200b029 0x1000000 0xdd601 0xb301b301 0xb301b301 0xb301b329 0x1000000 0x200c0 0x29010000 0xdd6 0x1e110077 0x1177a211 0x77771177 0x29010000 0x200 0xd0290100 0x7 0xd6771177 0x77117729 0x1000000 0x200e0 0x29010000 0xdd6 0x1e113c3c 0x113c5111 0x3c3c113c 0x29010000 0x200 0xf0290100 0x7 0xd63c113c 0x3c113c29 0x1000000 0x20090 0x29010000 0x2d6 0x80290100 0x2 0x812901 0x0 0x3d603ff 0x29010000 0x200 0x80290100 0x1d 0xca018e95 0x9da4abb2 0xbac1c8cf 0xd7dee5ec 0xf4e8ff87 0xff87ff05 0x3050305 0x3290100 0x2 0x2901 0x0 0x2c61029 0x1000000 0x13c790 0xa9aaaaaa 0xaaaaaa99 0x88888877 0x66555555 0x55290100 0x2 0x2901 0x0 0x2c61129 0x1000000 0x13c790 0x99aaaaaa 0xaaaa9a99 0x88888877 0x66665555 0x55290100 0x2 0x2901 0x0 0x2c61229 0x1000000 0x13c790 0x99a9aaaa 0xaaaa9999 0x88888877 0x66666655 0x55290100 0x2 0x2901 0x0 0x2c61329 0x1000000 0x13c790 0x9999aaaa 0xaa9a9999 0x88888877 0x66666666 0x55290100 0x2 0x2901 0x0 0x2c61429 0x1000000 0x13c790 0x9999a9aa 0xaa999999 0x88888877 0x66666666 0x66290100 0x2 0x2901 0x0 0x2c61529 0x1000000 0x13c790 0x999999aa 0x9a999999 0x88888877 0x77666666 0x66290100 0x2 0x2901 0x0 0x2c61629 0x1000000 0x13c790 0x999999a9 0x99999999 0x88888877 0x77776666 0x66290100 0x2 0x2901 0x0 0x2001729 0x1000000 0x13c780 0x99999999 0x99999999 0x88888877 0x77777766 0x66290100 0x2 0x2901 0x0 0x2001829 0x1000000 0x13c780 0x98999999 0x98999999 0x88888877 0x77777777 0x66290100 0x2 0x2901 0x0 0x2c61929 0x1000000 0x13c780 0x88999999 0x88999999 0x88888877 0x77777777 0x77290100 0x2 0x2901 0x0 0x2c61a29 0x1000000 0x13c780 0x88989999 0x88989999 0x88888888 0x77777777 0x77290100 0x2 0x2901 0x0 0x2c61b29 0x1000000 0x13c780 0x88889999 0x88889999 0x88888888 0x88777777 0x77290100 0x2 0x2901 0x0 0x2c61c29 0x1000000 0x13c780 0x88889899 0x88889899 0x88888888 0x88887777 0x77290100 0x2 0x2901 0x0 0x2001d29 0x1000000 0x13c780 0x88888899 0x88888899 0x88888888 0x88888877 0x77290100 0x2 0x2901 0x0 0x2c61e29 0x1000000 0x13c780 0x88888898 0x88888898 0x88888888 0x88888878 0x78290100 0x2 0x2901 0x0 0x2c61f29 0x1000000 0x13c780 0x88888888 0x88888888 0x88888888 0x88888888 0x88290100 0x2 0x2901 0x0 0x2c60029 0x1000000 0x200c2 0x29010000 0x2f5 0xc0290100 0x2 0x802901 0x0 0x2c40129 0x1000000 0x20088 0x29010000 0x2c4 0x80290100 0x2 0xa02901 0x0 0x2c10229 0x1000000 0x20000 0x29010000 0x4ff 0xffffff29 0x1000000 0x25100 0x29010000 0x253 0x24290100 0x2 0x55b00501 0x7800 0x2110005 0x1000014 0x22900>;
				qcom,mdss-dsi-off-command = [05 01 00 00 14 00 02 28 00 05 01 00 00 78 00 02 10 00];
				qcom,panel-ce-cmds = [29 01 00 00 00 00 02 55 83];
				qcom,panel-ce-off-cmds = [29 01 00 00 00 00 02 55 00];
				qcom,panel-ce-level1-cmds = [29 01 00 00 00 00 02 55 b0];
				qcom,panel-ce-level2-cmds = [29 01 00 00 00 00 02 55 90];
				qcom,panel-ce-level3-cmds = [29 01 00 00 00 00 02 55 81];
				qcom,panel-cabc-ui-cmds = [29 01 00 00 00 00 02 55 91];
				qcom,panel-cabc-moving-cmds = [29 01 00 00 00 00 02 55 92];
				qcom,panel-cabc-off-cmds = [29 01 00 00 00 00 02 55 00];
				qcom,panel-backlight-response-curve = <0x10102 0x2030304 0x4040405 0x6070708 0x809090a 0xa0b0b0c 0xc0c0d0d 0xd0e0e0e 0xf0f0f10 0x10101111 0x11121212 0x13131314 0x14151516 0x17181819 0x1a1b1b1c 0x1d1d1e1f 0x21212122 0x23232425 0x26262727 0x28282929 0x2a2a2b2b 0x2c2c2d2d 0x2e2e2f2f 0x30303131 0x31323233 0x33333434 0x34353738 0x3a3b3d3e 0x3f404142 0x43444546 0x4748494a 0x4b4c4d4e 0x4f505151 0x52535454 0x55565757 0x58595a5b 0x5c5e5f61 0x62646567 0x686a6b6c 0x6e6f7172 0x74757778 0x7a7b7d7e 0x7f818284 0x8587898b 0x8c8d8e90 0x91929495 0x97989a9b 0x9d9ea0a1 0xa3a4a5a7 0xa8aaabad 0xaeafb1b3 0xb4b5b7b8 0xbabbbdbe 0xbfc1c4c5 0xc7c8c9ca 0xcbcdced0 0xd1d3d4d6 0xd7d9dadb 0xdddee0e1 0xe3e4e6e7 0xe9eaeced 0xeef0f1f3 0xf4f6f7f9 0xfafcfdff>;
				qcom,mdss-dsi-on-command-state = "dsi_lp_mode";
				qcom,mdss-dsi-off-command-state = "dsi_lp_mode";
				qcom,panel-alive-reg-content = [0a 01 9c 0b 01 00 0d 01 00];
				qcom,mdss-dsi-panel-status-command = [06 01 00 01 05 00 02 0a 08];
				qcom,mdss-dsi-panel-status-command-state = "dsi_lp_mode";
				qcom,mdss-dsi-panel-status-check-mode = "reg_read";
				qcom,mdss-dsi-h-sync-pulse = <0x1>;
				qcom,mdss-dsi-traffic-mode = "burst_mode";
				qcom,mdss-dsi-bllp-eof-power-mode;
				qcom,mdss-dsi-bllp-power-mode;
				qcom,mdss-dsi-lane-0-state;
				qcom,mdss-dsi-lane-1-state;
				qcom,mdss-dsi-lane-2-state;
				qcom,mdss-dsi-lane-3-state;
				qcom,mdss-dsi-panel-timings = <0x81201800 0x302e1c22 0x27030400>;
				qcom,mdss-dsi-t-clk-post = <0x20>;
				qcom,mdss-dsi-t-clk-pre = <0x2c>;
				qcom,mdss-dsi-bl-min-level = <0x1>;
				qcom,mdss-dsi-bl-max-level = <0xff>;
				qcom,mdss-dsi-dma-trigger = "trigger_sw";
				qcom,mdss-dsi-mdp-trigger = "none";
				qcom,mdss-dsi-bl-pmic-control-type = "bl_ctrl_dcs";
				qcom,mdss-dsi-reset-sequence = <0x1 0xa 0x0 0x2 0x1 0xa 0x0 0x2 0x1 0x3c>;
				qcom,mdss-pan-physical-width-dimension = <0x44>;
				qcom,mdss-pan-physical-height-dimension = <0x79>;
				qcom,mdss-dsi-lp11-init;
				qcom,mdss-dsi-init-delay-us = <0xc8>;
				};

};
