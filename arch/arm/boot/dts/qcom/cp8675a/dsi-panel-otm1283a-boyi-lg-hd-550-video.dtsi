/* Copyright (c) 2014, The Linux Foundation. All rights reserved.
 *
 * This program is free software; you can redistribute it and/or modify
 * it under the terms of the GNU General Public License version 2 and
 * only version 2 as published by the Free Software Foundation.
 *
 * This program is distributed in the hope that it will be useful,
 * but WITHOUT ANY WARRANTY; without even the implied warranty of
 * MERCHANTABILITY or FITNESS FOR A PARTICULAR PURPOSE.  See the
 * GNU General Public License for more details.
 */

&mdss_mdp {
	dsi_otm1283a_boyi_lg_hd: qcom,mdss_dsi_otm1283a_boyi_lg_hd_video {
				qcom,cont-splash-enabled;
				qcom,mdss-dsi-panel-name = "LCD_TYPE_OTM1283A_BOYI_LG_HD_550";
				qcom,mdss-dsi-panel-controller = <0x6b>;
				qcom,mdss-dsi-panel-type = "dsi_video_mode";
				qcom,mdss-dsi-panel-destination = "display_1";
				qcom,mdss-dsi-panel-framerate = <0x37>;
				qcom,mdss-dsi-virtual-channel-id = <0x0>;
				qcom,mdss-dsi-stream = <0x0>;
				qcom,mdss-dsi-panel-width = <0x2d0>;
				qcom,mdss-dsi-panel-height = <0x500>;
				qcom,mdss-dsi-h-front-porch = <0x2c>;
				qcom,mdss-dsi-h-back-porch = <0x2a>;
				qcom,mdss-dsi-h-pulse-width = <0x6>;
				qcom,mdss-dsi-h-sync-skew = <0x0>;
				qcom,mdss-dsi-v-front-porch = <0x10>;
				qcom,mdss-dsi-v-back-porch = <0xe>;
				qcom,mdss-dsi-v-pulse-width = <0x2>;
				qcom,mdss-dsi-h-left-border = <0x0>;
				qcom,mdss-dsi-h-right-border = <0x0>;
				qcom,mdss-dsi-v-top-border = <0x0>;
				qcom,mdss-dsi-v-bottom-border = <0x0>;
				qcom,mdss-dsi-bpp = <0x18>;
				qcom,mdss-dsi-underflow-color = <0xff>;
				qcom,mdss-dsi-border-color = <0x0>;
				qcom,mdss-dsi-pixel-packing = <0x0>;
				qcom,mdss-dsi-on-command = [29 01 00 00 00 00 02 00 00 29 01 00 00 00 00 04 ff 12 83 01 29 01 00 00 00 00 02 00 80 29 01 00 00 00 00 03 ff 12 83 29 01 00 00 00 00 02 00 c6 29 01 00 00 00 00 02 b0 03 29 01 00 00 00 00 02 00 b9 29 01 00 00 00 00 02 b0 51 29 01 00 00 00 00 02 00 80 29 01 00 00 00 00 0a c0 00 64 00 0f 11 00 64 0f 11 29 01 00 00 00 00 02 00 90 29 01 00 00 00 00 07 c0 00 55 00 01 00 04 29 01 00 00 00 00 02 00 a4 29 01 00 00 00 00 02 c0 00 29 01 00 00 00 00 02 00 b3 29 01 00 00 00 00 03 c0 00 50 29 01 00 00 00 00 02 00 81 29 01 00 00 00 00 02 c1 55 29 01 00 00 00 00 02 00 80 29 01 00 00 00 00 02 c4 30 29 01 00 00 00 00 02 00 81 29 01 00 00 00 00 02 c4 82 29 01 00 00 00 00 02 00 82 29 01 00 00 00 00 02 c4 02 29 01 00 00 00 00 02 00 87 29 01 00 00 00 00 02 c4 18 29 01 00 00 00 00 02 00 8a 29 01 00 00 00 00 02 c4 40 29 01 00 00 00 00 02 00 8b 29 01 00 00 00 00 02 c4 00 29 01 00 00 00 00 02 00 90 29 01 00 00 00 00 02 c4 52 29 01 00 00 00 00 02 00 a0 29 01 00 00 00 00 0f c4 05 10 06 02 05 15 10 05 10 07 02 05 15 10 29 01 00 00 00 00 02 00 b0 29 01 00 00 00 00 03 c4 00 00 29 01 00 00 00 00 02 00 90 29 01 00 00 00 00 02 c5 50 29 01 00 00 00 00 02 00 91 29 01 00 00 00 00 03 c5 48 50 29 01 00 00 00 00 02 00 94 29 01 00 00 00 00 02 c5 66 29 01 00 00 00 00 02 00 b0 29 01 00 00 00 00 03 c5 04 38 29 01 00 00 00 00 02 00 b4 29 01 00 00 00 00 02 c5 c0 29 01 00 00 00 00 02 00 bb 29 01 00 00 00 00 02 c5 80 29 01 00 00 00 00 02 00 b5 29 01 00 00 00 00 07 c5 3b ed 30 3b ed 30 29 01 00 00 00 00 02 00 b1 29 01 00 00 00 00 02 c6 05 29 01 00 00 00 00 02 00 90 29 01 00 00 00 00 05 f5 02 11 02 11 29 01 00 00 00 00 02 00 b2 29 01 00 00 00 00 03 f5 00 00 29 01 00 00 00 00 02 00 b4 29 01 00 00 00 00 03 f5 00 00 29 01 00 00 00 00 02 00 b6 29 01 00 00 00 00 03 f5 00 00 29 01 00 00 00 00 02 00 b8 29 01 00 00 00 00 03 f5 00 00 29 01 00 00 00 00 02 00 94 29 01 00 00 00 00 02 f5 02 29 01 00 00 00 00 02 00 ba 29 01 00 00 00 00 02 f5 03 29 01 00 00 00 00 02 00 c3 29 01 00 00 00 00 02 f5 81 29 01 00 00 00 00 02 00 b1 29 01 00 00 00 00 02 c6 05 29 01 00 00 00 00 02 00 80 29 01 00 00 00 00 0c cb 00 00 00 00 00 00 00 00 00 00 00 29 01 00 00 00 00 02 00 90 29 01 00 00 00 00 10 cb 00 00 00 00 00 00 00 00 00 00 00 ff 00 ff 00 29 01 00 00 00 00 02 00 a0 29 01 00 00 00 00 10 cb ff 00 ff 00 00 00 00 00 00 00 00 00 00 00 00 29 01 00 00 00 00 02 00 b0 29 01 00 00 00 00 10 cb 00 00 00 ff 00 ff 00 ff 00 ff 00 00 00 00 00 29 01 00 00 00 00 02 00 c0 29 01 00 00 00 00 10 cb 00 00 00 00 05 05 00 00 05 00 05 05 00 05 05 29 01 00 00 00 00 02 00 d0 29 01 00 00 00 00 10 cb 05 05 05 00 00 00 00 00 00 00 00 05 05 00 00 29 01 00 00 00 00 02 00 e0 29 01 00 00 00 00 0f cb 05 00 05 05 00 05 05 05 05 05 00 00 00 00 29 01 00 00 00 00 02 00 f0 29 01 00 00 00 00 0c cb ff ff ff ff ff ff ff ff ff ff ff 29 01 00 00 00 00 02 00 80 29 01 00 00 00 00 10 cc 00 00 00 00 2e 2d 00 00 29 00 2a 0c 00 0a 10 29 01 00 00 00 00 02 00 90 29 01 00 00 00 00 10 cc 0e 02 04 00 00 00 00 00 00 00 00 2e 2d 00 00 29 01 00 00 00 00 02 00 a0 29 01 00 00 00 00 0f cc 29 00 2a 0b 00 09 0f 0d 01 03 00 00 00 00 29 01 00 00 00 00 02 00 b0 29 01 00 00 00 00 10 cc 00 00 00 00 2d 2e 00 00 29 00 2a 0f 00 09 0b 29 01 00 00 00 00 02 00 c0 29 01 00 00 00 00 10 cc 0d 03 01 00 00 00 00 00 00 00 00 2d 2e 00 00 29 01 00 00 00 00 02 00 d0 29 01 00 00 00 00 0f cc 29 00 2a 10 00 0a 0c 0e 04 02 00 00 00 00 29 01 00 00 00 00 02 00 80 29 01 00 00 00 00 0d ce 8b 03 10 8a 03 10 89 03 10 88 03 10 29 01 00 00 00 00 02 00 90 29 01 00 00 00 00 0f ce f0 00 00 f0 00 00 f0 00 00 f0 00 00 00 00 29 01 00 00 00 00 02 00 a0 29 01 00 00 00 00 0f ce 38 07 84 fe 00 10 00 38 06 84 ff 00 10 00 29 01 00 00 00 00 02 00 b0 29 01 00 00 00 00 0f ce 38 05 85 00 00 10 00 38 04 85 01 00 10 00 29 01 00 00 00 00 02 00 c0 29 01 00 00 00 00 0f ce 38 03 85 02 00 10 00 38 02 85 03 00 10 00 29 01 00 00 00 00 02 00 d0 29 01 00 00 00 00 0f ce 38 01 85 04 00 10 00 38 00 85 05 00 10 00 29 01 00 00 00 00 02 00 80 29 01 00 00 00 00 0f cf 70 00 00 10 00 00 00 70 00 00 10 00 00 00 29 01 00 00 00 00 02 00 90 29 01 00 00 00 00 0f cf 70 00 00 10 00 00 00 70 00 00 10 00 00 00 29 01 00 00 00 00 02 00 a0 29 01 00 00 00 00 0f cf 70 00 00 10 00 00 00 70 00 00 10 00 00 00 29 01 00 00 00 00 02 00 b0 29 01 00 00 00 00 0f cf 70 00 00 10 00 00 00 70 00 00 10 00 00 00 29 01 00 00 00 00 02 00 c0 29 01 00 00 00 00 0c cf 04 01 20 20 00 00 01 80 00 03 08 29 01 00 00 00 00 02 00 c2 29 01 00 00 00 00 02 f5 c0 29 01 00 00 00 00 02 00 80 29 01 00 00 00 00 02 c4 01 29 01 00 00 00 00 02 00 88 29 01 00 00 00 00 02 c4 80 29 01 00 00 00 00 02 00 00 29 01 00 00 00 00 03 d8 bc bc 29 01 00 00 00 00 02 00 00 29 01 00 00 00 00 02 d9 8b 29 01 00 00 00 00 02 00 00 29 01 00 00 00 00 11 e1 04 0b 10 0d 06 0e 0c 0a 04 07 0c 09 10 16 12 08 29 01 00 00 00 00 02 00 00 29 01 00 00 00 00 11 e2 04 0b 10 0d 07 0e 0c 0a 04 09 0c 09 10 16 12 08 29 01 00 00 00 00 02 00 00 29 01 00 00 00 00 22 ec 40 44 44 44 44 44 44 44 44 44 44 44 44 44 44 44 44 44 44 44 44 44 44 44 44 44 44 44 44 44 44 44 04 29 01 00 00 00 00 02 00 00 29 01 00 00 00 00 22 ed 40 44 44 34 44 44 44 44 44 44 43 44 44 44 44 44 34 44 44 44 44 44 34 44 44 44 44 44 44 43 44 44 04 29 01 00 00 00 00 02 00 00 29 01 00 00 00 00 22 ee 40 34 44 34 44 34 44 34 44 44 43 44 43 44 43 44 34 44 34 44 34 44 34 44 44 43 44 43 44 43 44 43 04 29 01 00 00 00 00 02 00 a0 29 01 00 00 00 00 0d d6 01 00 01 00 01 00 01 b3 01 f3 01 b3 29 01 00 00 00 00 02 00 b0 29 01 00 00 00 00 0d d6 01 b3 01 b3 01 b3 01 b3 01 b3 01 b3 29 01 00 00 00 00 02 00 c0 29 01 00 00 00 00 0d d6 1e 11 00 77 11 77 a2 11 77 77 11 77 29 01 00 00 00 00 02 00 d0 29 01 00 00 00 00 07 d6 77 11 77 77 11 77 29 01 00 00 00 00 02 00 e0 29 01 00 00 00 00 0d d6 1e 11 3c 3c 11 3c 51 11 3c 3c 11 3c 29 01 00 00 00 00 02 00 f0 29 01 00 00 00 00 07 d6 3c 11 3c 3c 11 3c 29 01 00 00 00 00 02 00 90 29 01 00 00 00 00 02 d6 80 29 01 00 00 00 00 02 00 81 29 01 00 00 00 00 03 d6 03 ff 29 01 00 00 00 00 02 00 80 29 01 00 00 00 00 1d ca 01 8e 95 9d a4 ab b2 ba c1 c8 cf d7 de e5 ec f4 e8 ff 87 ff 87 ff 05 03 05 03 05 03 29 01 00 00 00 00 02 00 00 29 01 00 00 00 00 02 c6 10 29 01 00 00 00 00 13 c7 90 a9 aa aa aa aa aa aa 99 88 88 88 77 66 55 55 55 55 29 01 00 00 00 00 02 00 00 29 01 00 00 00 00 02 c6 11 29 01 00 00 00 00 13 c7 90 99 aa aa aa aa aa 9a 99 88 88 88 77 66 66 55 55 55 29 01 00 00 00 00 02 00 00 29 01 00 00 00 00 02 c6 12 29 01 00 00 00 00 13 c7 90 99 a9 aa aa aa aa 99 99 88 88 88 77 66 66 66 55 55 29 01 00 00 00 00 02 00 00 29 01 00 00 00 00 02 c6 13 29 01 00 00 00 00 13 c7 90 99 99 aa aa aa 9a 99 99 88 88 88 77 66 66 66 66 55 29 01 00 00 00 00 02 00 00 29 01 00 00 00 00 02 c6 14 29 01 00 00 00 00 13 c7 90 99 99 a9 aa aa 99 99 99 88 88 88 77 66 66 66 66 66 29 01 00 00 00 00 02 00 00 29 01 00 00 00 00 02 c6 15 29 01 00 00 00 00 13 c7 90 99 99 99 aa 9a 99 99 99 88 88 88 77 77 66 66 66 66 29 01 00 00 00 00 02 00 00 29 01 00 00 00 00 02 c6 16 29 01 00 00 00 00 13 c7 90 99 99 99 a9 99 99 99 99 88 88 88 77 77 77 66 66 66 29 01 00 00 00 00 02 00 00 29 01 00 00 00 00 02 00 17 29 01 00 00 00 00 13 c7 80 99 99 99 99 99 99 99 99 88 88 88 77 77 77 77 66 66 29 01 00 00 00 00 02 00 00 29 01 00 00 00 00 02 00 18 29 01 00 00 00 00 13 c7 80 98 99 99 99 98 99 99 99 88 88 88 77 77 77 77 77 66 29 01 00 00 00 00 02 00 00 29 01 00 00 00 00 02 c6 19 29 01 00 00 00 00 13 c7 80 88 99 99 99 88 99 99 99 88 88 88 77 77 77 77 77 77 29 01 00 00 00 00 02 00 00 29 01 00 00 00 00 02 c6 1a 29 01 00 00 00 00 13 c7 80 88 98 99 99 88 98 99 99 88 88 88 88 77 77 77 77 77 29 01 00 00 00 00 02 00 00 29 01 00 00 00 00 02 c6 1b 29 01 00 00 00 00 13 c7 80 88 88 99 99 88 88 99 99 88 88 88 88 88 77 77 77 77 29 01 00 00 00 00 02 00 00 29 01 00 00 00 00 02 c6 1c 29 01 00 00 00 00 13 c7 80 88 88 98 99 88 88 98 99 88 88 88 88 88 88 77 77 77 29 01 00 00 00 00 02 00 00 29 01 00 00 00 00 02 00 1d 29 01 00 00 00 00 13 c7 80 88 88 88 99 88 88 88 99 88 88 88 88 88 88 88 77 77 29 01 00 00 00 00 02 00 00 29 01 00 00 00 00 02 c6 1e 29 01 00 00 00 00 13 c7 80 88 88 88 98 88 88 88 98 88 88 88 88 88 88 88 78 78 29 01 00 00 00 00 02 00 00 29 01 00 00 00 00 02 c6 1f 29 01 00 00 00 00 13 c7 80 88 88 88 88 88 88 88 88 88 88 88 88 88 88 88 88 88 29 01 00 00 00 00 02 00 00 29 01 00 00 00 00 02 c6 00 29 01 00 00 00 00 02 00 a0 29 01 00 00 00 00 02 c1 02 29 01 00 00 00 00 02 00 80 29 01 00 00 00 00 03 ff ff ff 29 01 00 00 00 00 02 00 00 29 01 00 00 00 00 04 ff ff ff ff 29 01 00 00 00 00 02 51 00 29 01 00 00 00 00 02 53 24 29 01 00 00 00 00 02 55 b0 05 01 00 00 78 00 02 11 00 05 01 00 00 14 00 02 29 00];
				qcom,mdss-dsi-off-command = [05 01 00 00 14 00 02 28 00 05 01 00 00 78 00 02 10 00];
				qcom,panel-ce-cmds = [29 01 00 00 00 00 02 55 b1];
				qcom,panel-ce-off-cmds = [29 01 00 00 00 00 02 55 00];
				qcom,panel-ce-level1-cmds = [29 01 00 00 00 00 02 55 b0];
				qcom,panel-ce-level2-cmds = [29 01 00 00 00 00 02 55 90];
				qcom,panel-ce-level3-cmds = [29 01 00 00 00 00 02 55 81];
				qcom,panel-cabc-ui-cmds = [29 01 00 00 00 00 02 55 91];
				qcom,panel-cabc-moving-cmds = [29 01 00 00 00 00 02 55 92];
				qcom,panel-cabc-off-cmds = [29 01 00 00 00 00 02 55 00];
				qcom,panel-backlight-response-curve = <0x10202 0x3030304 0x4040405 0x5060607 0x7080809 0x90a0a0b 0xb0c0c0d 0xd0e0e0f 0xf101011 0x11121213 0x13131314 0x14141515 0x15161616 0x17181819 0x1a1b1b1c 0x1d1d1e1f 0x21212122 0x23232425 0x26262727 0x28282929 0x2a2a2b2b 0x2c2c2d2d 0x2e2e2f2f 0x30303131 0x31323233 0x33333434 0x34353738 0x3a3b3d3e 0x3f404142 0x43444546 0x4748494a 0x4b4c4d4e 0x4f505151 0x52535454 0x55565757 0x58595a5b 0x5c5e5f61 0x62646567 0x686a6b6c 0x6e6f7172 0x74757778 0x7a7b7d7e 0x7f818284 0x8587898b 0x8c8d8e90 0x91929495 0x97989a9b 0x9d9ea0a1 0xa3a4a5a7 0xa8aaabad 0xaeafb1b3 0xb4b5b7b8 0xbabbbdbe 0xbfc1c4c5 0xc7c8c9ca 0xcbcdced0 0xd1d3d4d6 0xd7d9dadb 0xdddee0e1 0xe3e4e6e7 0xe9eaeced 0xeef0f1f3 0xf4f6f7f9 0xfafcfdff>;
				qcom,mdss-dsi-on-command-state = "dsi_lp_mode";
				qcom,mdss-dsi-off-command-state = "dsi_lp_mode";
				qcom,panel-alive-reg-content = [0a 01 9c 0b 01 00 0d 01 00];
				qcom,mdss-dsi-panel-status-command = [06 01 00 01 05 00 02 0a 08];
				qcom,mdss-dsi-panel-status-command-state = "dsi_lp_mode";
				qcom,mdss-dsi-panel-status-check-mode = "reg_read";
				qcom,mdss-dsi-h-sync-pulse = <0x1>;
				qcom,mdss-dsi-traffic-mode = "burst_mode";
				qcom,mdss-dsi-bllp-eof-power-mode;
				qcom,mdss-dsi-bllp-power-mode;
				qcom,mdss-dsi-lane-0-state;
				qcom,mdss-dsi-lane-1-state;
				qcom,mdss-dsi-lane-2-state;
				qcom,mdss-dsi-lane-3-state;
				qcom,mdss-dsi-panel-timings = <0x81201800 0x302e1c22 0x27030400>;
				qcom,mdss-dsi-t-clk-post = <0x20>;
				qcom,mdss-dsi-t-clk-pre = <0x2c>;
				qcom,mdss-dsi-bl-min-level = <0x1>;
				qcom,mdss-dsi-bl-max-level = <0xff>;
				qcom,mdss-dsi-dma-trigger = "trigger_sw";
				qcom,mdss-dsi-mdp-trigger = "none";
				qcom,mdss-dsi-bl-pmic-control-type = "bl_ctrl_dcs";
				qcom,mdss-dsi-reset-sequence = <0x1 0xa 0x0 0x2 0x1 0xa 0x0 0x2 0x1 0x3c>;
				qcom,mdss-pan-physical-width-dimension = <0x44>;
				qcom,mdss-pan-physical-height-dimension = <0x79>;
				qcom,mdss-dsi-lp11-init;
				qcom,mdss-dsi-init-delay-us = <0xc8>;
				};

};
