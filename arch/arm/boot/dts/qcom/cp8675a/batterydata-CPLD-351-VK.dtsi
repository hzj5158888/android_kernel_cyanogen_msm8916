/* Copyright (c) 2013, The Linux Foundation. All rights reserved.
 *
 * This program is free software; you can redistribute it and/or modify
 * it under the terms of the GNU General Public License version 2 and
 * only version 2 as published by the Free Software Foundation.
 *
 * This program is distributed in the hope that it will be useful,
 * but WITHOUT ANY WARRANTY; without even the implied warranty of
 * MERCHANTABILITY or FITNESS FOR A PARTICULAR PURPOSE.  See the
 * GNU General Public License for more details.
 */
qcom,CPLD-351-VK-data {
	qcom,fcc-mah = <0x9c4>;
	qcom,default-rbatt-mohm = <0xac>;
	qcom,rbatt-capacitive-mohm = <0x0>;
	qcom,flat-ocv-threshold-uv = <0x39fbc0>;
	qcom,max-voltage-uv = <0x426030>;
	qcom,v-cutoff-uv = <0x33e140>;
	qcom,chg-term-ua = <0x186a0>;
	qcom,batt-id-kohm = <0x44>;
	qcom,battery-type = "CPLD-351-VK";

	qcom,rbatt-sf-lut {
		qcom,lut-col-legend = <0xffffffec 0x0 0x19 0x28 0x3c>;
		qcom,lut-row-legend = <0x64 0x5f 0x5a 0x55 0x50 0x4b 0x46 0x41 0x3c 0x37 0x32 0x2d 0x28 0x23 0x1e 0x19 0x14 0x10 0xd 0xb 0xa 0x9 0x8 0x7 0x6 0x5 0x4 0x3 0x2 0x1 0x0>;
		qcom,lut-data = <0x54e 0xf7 0x64 0x57 0x52 0x54c 0xf8 0x64 0x57 0x52 0x511 0xfb 0x65 0x57 0x52 0x4cf 0xfb 0x66 0x58 0x53 0x4a4 0xf7 0x69 0x59 0x54 0x450 0x100 0x6f 0x5d 0x55 0x451 0xef 0x72 0x60 0x57 0x458 0xf2 0x74 0x63 0x59 0x465 0xf2 0x6b 0x5e 0x58 0x47c 0xf5 0x65 0x58 0x54 0x497 0xfb 0x66 0x58 0x53 0x4b5 0x103 0x67 0x59 0x54 0x4d7 0x10d 0x69 0x5a 0x56 0x4ff 0x11b 0x6b 0x5c 0x57 0x532 0x127 0x6b 0x5b 0x56 0x579 0x137 0x6b 0x5a 0x54 0x5da 0x159 0x6c 0x5a 0x55 0x6a1 0x18d 0x6e 0x5b 0x55 0x72d 0x1ab 0x6e 0x5b 0x55 0x87e 0x1c6 0x6f 0x5b 0x55 0x97b 0x1e2 0x71 0x5c 0x56 0xaac 0x202 0x73 0x5d 0x57 0xc31 0x22b 0x77 0x5f 0x58 0xe2d 0x25a 0x7c 0x60 0x58 0x10e4 0x29a 0x7b 0x5f 0x57 0x1447 0x2fe 0x7d 0x5f 0x57 0x19f9 0x393 0x83 0x61 0x58 0x21d0 0x469 0x8b 0x65 0x5b 0x2e8d 0x5ec 0x9b 0x6d 0x62 0x4c83 0x8d7 0xc1 0x87 0x78 0x34274 0x2382c 0xc01 0x3b08 0xdbd8>;
	};

	qcom,fcc-temp-lut {
		qcom,lut-col-legend = <0xffffffec 0x0 0x19 0x28 0x3c>;
		qcom,lut-data = <0xa2a 0xa24 0xa25 0xa1d 0xa19>;
	};

	qcom,pc-temp-ocv-lut {
		qcom,lut-col-legend = <0xffffffec 0x0 0x19 0x28 0x3c>;
		qcom,lut-row-legend = <0x64 0x5f 0x5a 0x55 0x50 0x4b 0x46 0x41 0x3c 0x37 0x32 0x2d 0x28 0x23 0x1e 0x19 0x14 0x10 0xd 0xb 0xa 0x9 0x8 0x7 0x6 0x5 0x4 0x3 0x2 0x1 0x0>;
		qcom,lut-data = <0x10ea 0x10df 0x10e1 0x10d7 0x10d5 0x1086 0x1098 0x109e 0x1099 0x1097 0x103f 0x105e 0x1064 0x1060 0x105e 0x1008 0x1027 0x102d 0x1029 0x1027 0xfd2 0xff0 0xff9 0xff5 0xff3 0xf76 0xfba 0xfcc 0xfc6 0xfc3 0xf4b 0xf6f 0xf8f 0xf96 0xf96 0xf25 0xf50 0xf6b 0xf6c 0xf6c 0xf05 0xf2d 0xf3b 0xf3c 0xf3e 0xeeb 0xf0d 0xf16 0xf15 0xf15 0xed5 0xef1 0xefb 0xefa 0xefa 0xec3 0xed9 0xee5 0xee5 0xee4 0xeb2 0xec5 0xed3 0xed3 0xed2 0xea2 0xeb7 0xec3 0xec3 0xec2 0xe91 0xeaa 0xeb4 0xeb1 0xeab 0xe7e 0xe9a 0xea5 0xe9d 0xe91 0xe66 0xe8c 0xe94 0xe8b 0xe7d 0xe50 0xe83 0xe82 0xe7a 0xe6c 0xe3b 0xe7a 0xe70 0xe68 0xe5a 0xe29 0xe72 0xe6a 0xe61 0xe55 0xe1e 0xe6c 0xe68 0xe60 0xe54 0xe11 0xe65 0xe65 0xe5e 0xe52 0xe01 0xe5c 0xe63 0xe5b 0xe4e 0xdef 0xe4d 0xe5d 0xe54 0xe45 0xddc 0xe37 0xe4a 0xe41 0xe2f 0xdc2 0xe18 0xe26 0xe1d 0xe0a 0xd9e 0xdef 0xdf6 0xdee 0xdda 0xd72 0xdb6 0xdb9 0xdb2 0xd9d 0xd31 0xd67 0xd67 0xd62 0xd4c 0xcbd 0xce4 0xcef 0xcec 0xcd0 0xbb8 0xbb8 0xbd8 0xbb8 0xbb8>;
	};
};
